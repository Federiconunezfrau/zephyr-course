## my_driver_module/drivers/my_sensor/Kconfig
```kconfig
menuconfig CONFIG_MY_SENSOR
	bool "Enable my_sensor driver"
	default y
	select GPIO
    depends on DT_HAS_MY_SENSOR_ENABLED
	help
	  Enables the my_sensor driver
```

## my_driver_module/dts/bindings/my_sensor/my,sensor.yaml
```yaml
description: This is my driver's binding file
compatible: my,sensor
include: sensor-device.yaml

properties:
  gpio:
    type: phandle
    required: true
    description: GPIO for driving the LED
```

## twister-out/native_sim_native/host/homework.unit.ring_buf/Kconfig/boards/Kconfig
```kconfig
# Load Zephyr board Kconfig descriptions.
osource "/home/federico/Documents/Curso_Zephyr/taskworkspace/deps/zephyr/boards/native/native_sim/Kconfig"
```

## twister-out/native_sim_native/host/homework.unit.ring_buf/Kconfig/boards/Kconfig.defconfig
```kconfig
# Load Zephyr board defconfig descriptions.
osource "/home/federico/Documents/Curso_Zephyr/taskworkspace/deps/zephyr/boards/native/native_sim/Kconfig.defconfig"
```

## twister-out/native_sim_native/host/homework.unit.ring_buf/Kconfig/boards/Kconfig.native_sim
```kconfig
# Load board Kconfig descriptions.
osource "/home/federico/Documents/Curso_Zephyr/taskworkspace/deps/zephyr/boards/native/native_sim/Kconfig.native_sim"
```
