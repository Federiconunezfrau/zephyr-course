## app/boards/copy_board/board.yml
```yaml
board:
  name: copy_board
  full_name: Copy Board
  vendor: me
  socs:
    - name: stm32f103xb
```

## hello_world/boards/board_from_scratch/board.yml
```yaml
board:
  name: board_from_scratch
  full_name: Board Created from Scratch
  vendor: me
  socs:
    - name: stm32f103xb
```

## hello_world/boards/copy_board/Kconfig.copy_board
```kconfig
# Copyright (c) 2016 Open-RnD Sp. z o.o.
# SPDX-License-Identifier: Apache-2.0

config BOARD_COPY_BOARD
	select SOC_STM32F103XB
```
